/*
  ColdRoot Vision — ESP32-CAM On-Device Inference (full)
  ---------------------------------------------------------
  Captures a frame, runs it through the quantized freshness model
  (model_data.h, generated by convert_to_c_array.py), and publishes the
  result over MQTT so it can be merged into the ColdRoot dashboard alongside
  the existing temp/humidity/battery telemetry.

  LIBRARIES NEEDED (Arduino Library Manager):
    - TensorFlowLite_ESP32   (or Chirale_TensorFlowLite, either works)
    - PubSubClient           (MQTT)
    - ESP32 board package     (bundles esp32-camera)

  Board: AI-Thinker ESP32-CAM (pin map below). Adjust pins if using a
  different ESP32-CAM variant.

  Place model_data.h (output of convert_to_c_array.py) in this same folder
  before compiling.
*/

#include "esp_camera.h"
#include <WiFi.h>
#include <PubSubClient.h>
#include <TensorFlowLite_ESP32.h>
#include "tensorflow/lite/micro/all_ops_resolver.h"
#include "tensorflow/lite/micro/micro_interpreter.h"
#include "tensorflow/lite/schema/schema_generated.h"
#include "model_data.h"

// ---------------- camera pins (AI-Thinker ESP32-CAM board) ----------------
#define PWDN_GPIO_NUM   32
#define RESET_GPIO_NUM  -1
#define XCLK_GPIO_NUM    0
#define SIOD_GPIO_NUM   26
#define SIOC_GPIO_NUM   27
#define Y9_GPIO_NUM     35
#define Y8_GPIO_NUM     34
#define Y7_GPIO_NUM     39
#define Y6_GPIO_NUM     36
#define Y5_GPIO_NUM     21
#define Y4_GPIO_NUM     19
#define Y3_GPIO_NUM     18
#define Y2_GPIO_NUM      5
#define VSYNC_GPIO_NUM  25
#define HREF_GPIO_NUM   23
#define PCLK_GPIO_NUM   22

// ---------------- config: fill these in ----------------
const char* WIFI_SSID     = "YOUR_WIFI";
const char* WIFI_PASSWORD = "YOUR_PASSWORD";
const char* MQTT_BROKER   = "YOUR_BROKER_IP_OR_HOST";
const int   MQTT_PORT     = 1883;
const char* UNIT_ID       = "CS-101";               // match the unit id in your dashboard
const unsigned long CAPTURE_INTERVAL_MS = 15UL * 60UL * 1000UL;  // every 15 min — battery matters
const unsigned long WIFI_TIMEOUT_MS = 15000UL;
const unsigned long MQTT_TIMEOUT_MS = 8000UL;

char mqtt_topic[64];  // built at runtime from UNIT_ID

// ---------------- image / model geometry ----------------
constexpr int kImgWidth = 96;
constexpr int kImgHeight = 96;
constexpr int kImgChannels = 3;   // RGB — matches train_model.py's IMG_SIZE + preprocess_input

// ---------------- TFLite Micro setup ----------------
constexpr int kTensorArenaSize = 130 * 1024;  // headroom above a ~96x96x3 MobileNetV2(0.35) int8 model
static uint8_t tensor_arena[kTensorArenaSize];

const tflite::Model* tflite_model = nullptr;
tflite::MicroInterpreter* interpreter = nullptr;
TfLiteTensor* input_tensor = nullptr;
TfLiteTensor* output_tensor = nullptr;

WiFiClient espClient;
PubSubClient mqtt(espClient);

// ---------------- camera ----------------
bool setup_camera() {
  camera_config_t config;
  config.ledc_channel = LEDC_CHANNEL_0;
  config.ledc_timer   = LEDC_TIMER_0;
  config.pin_d0 = Y2_GPIO_NUM; config.pin_d1 = Y3_GPIO_NUM;
  config.pin_d2 = Y4_GPIO_NUM; config.pin_d3 = Y5_GPIO_NUM;
  config.pin_d4 = Y6_GPIO_NUM; config.pin_d5 = Y7_GPIO_NUM;
  config.pin_d6 = Y8_GPIO_NUM; config.pin_d7 = Y9_GPIO_NUM;
  config.pin_xclk  = XCLK_GPIO_NUM;  config.pin_pclk = PCLK_GPIO_NUM;
  config.pin_vsync = VSYNC_GPIO_NUM; config.pin_href = HREF_GPIO_NUM;
  config.pin_sscb_sda = SIOD_GPIO_NUM; config.pin_sscb_scl = SIOC_GPIO_NUM;
  config.pin_pwdn  = PWDN_GPIO_NUM;  config.pin_reset = RESET_GPIO_NUM;
  config.xclk_freq_hz = 20000000;
  config.pixel_format = PIXFORMAT_RGB565;
  config.frame_size   = FRAMESIZE_96X96;   // matches IMG_SIZE in train_model.py
  config.fb_count      = 1;
  config.grab_mode     = CAMERA_GRAB_LATEST;

  esp_err_t err = esp_camera_init(&config);
  if (err != ESP_OK) {
    Serial.printf("Camera init failed: 0x%x\n", err);
    return false;
  }
  return true;
}

// ---------------- model ----------------
bool setup_model() {
  tflite_model = tflite::GetModel(coldroot_freshness_model);
  if (tflite_model->version() != TFLITE_SCHEMA_VERSION) {
    Serial.println("Model schema version mismatch");
    return false;
  }

  static tflite::AllOpsResolver resolver;
  static tflite::MicroInterpreter static_interpreter(
      tflite_model, resolver, tensor_arena, kTensorArenaSize);
  interpreter = &static_interpreter;

  if (interpreter->AllocateTensors() != kTfLiteOk) {
    Serial.println("AllocateTensors() failed — increase kTensorArenaSize");
    return false;
  }

  input_tensor = interpreter->input(0);
  output_tensor = interpreter->output(0);

  Serial.printf("Input tensor bytes: %d (expected %d)\n",
                input_tensor->bytes, kImgWidth * kImgHeight * kImgChannels);
  return true;
}

// Converts one RGB565 pixel to 8-bit R, G, B channels.
inline void rgb565_to_rgb888(uint16_t pixel, uint8_t &r, uint8_t &g, uint8_t &b) {
  uint8_t r5 = (pixel >> 11) & 0x1F;
  uint8_t g6 = (pixel >> 5) & 0x3F;
  uint8_t b5 = pixel & 0x1F;
  r = (r5 << 3) | (r5 >> 2);   // 5-bit -> 8-bit
  g = (g6 << 2) | (g6 >> 4);   // 6-bit -> 8-bit
  b = (b5 << 3) | (b5 >> 2);   // 5-bit -> 8-bit
}

// Fills the model's int8 input tensor from a captured RGB565 frame,
// applying the same [-1, 1] scaling MobileNetV2's preprocess_input used
// during training, then quantizing with the tensor's own scale/zero_point
// (read from the model itself, not hardcoded) so this stays correct
// regardless of how the converter quantized things.
bool fill_input_from_frame(camera_fb_t* fb) {
  const int num_pixels = kImgWidth * kImgHeight;
  if ((int)(fb->len / 2) < num_pixels) {
    Serial.println("Frame buffer smaller than expected");
    return false;
  }
  if ((int)input_tensor->bytes < num_pixels * kImgChannels) {
    Serial.println("Input tensor smaller than expected");
    return false;
  }

  const float scale = input_tensor->params.scale;
  const int zero_point = input_tensor->params.zero_point;
  const uint16_t* px = reinterpret_cast<const uint16_t*>(fb->buf);

  for (int i = 0; i < num_pixels; i++) {
    uint8_t r, g, b;
    rgb565_to_rgb888(px[i], r, g, b);

    // MobileNetV2 preprocess_input: scale [0,255] -> [-1, 1]
    float rf = (r / 127.5f) - 1.0f;
    float gf = (g / 127.5f) - 1.0f;
    float bf = (b / 127.5f) - 1.0f;

    int idx = i * kImgChannels;
    input_tensor->data.int8[idx + 0] = (int8_t)round(rf / scale) + zero_point;
    input_tensor->data.int8[idx + 1] = (int8_t)round(gf / scale) + zero_point;
    input_tensor->data.int8[idx + 2] = (int8_t)round(bf / scale) + zero_point;
  }
  return true;
}

void publish_result(float confidence, bool is_stale) {
  char payload[160];
  snprintf(payload, sizeof(payload),
           "{\"unit\":\"%s\",\"visualFreshness\":\"%s\",\"confidence\":%.3f}",
           UNIT_ID, is_stale ? "spoiling" : "fresh", confidence);

  if (mqtt.publish(mqtt_topic, payload)) {
    Serial.printf("Published to %s: %s\n", mqtt_topic, payload);
  } else {
    Serial.println("MQTT publish failed");
  }
}

bool run_inference() {
  camera_fb_t* fb = esp_camera_fb_get();
  if (!fb) {
    Serial.println("Capture failed");
    return false;
  }

  bool ok = fill_input_from_frame(fb);
  esp_camera_fb_return(fb);
  if (!ok) return false;

  if (interpreter->Invoke() != kTfLiteOk) {
    Serial.println("Inference failed");
    return false;
  }

  // Dequantize the sigmoid output back to a 0-1 confidence score.
  const float out_scale = output_tensor->params.scale;
  const int out_zero_point = output_tensor->params.zero_point;
  int8_t raw = output_tensor->data.int8[0];
  float confidence = (raw - out_zero_point) * out_scale;
  confidence = constrain(confidence, 0.0f, 1.0f);

  bool is_stale = confidence > 0.5f;
  publish_result(confidence, is_stale);
  return true;
}

bool connect_wifi() {
  WiFi.mode(WIFI_STA);
  WiFi.begin(WIFI_SSID, WIFI_PASSWORD);
  unsigned long start = millis();
  while (WiFi.status() != WL_CONNECTED) {
    if (millis() - start > WIFI_TIMEOUT_MS) {
      Serial.println("WiFi connect timed out");
      return false;
    }
    delay(300);
  }
  return true;
}

bool connect_mqtt() {
  mqtt.setServer(MQTT_BROKER, MQTT_PORT);
  unsigned long start = millis();
  while (!mqtt.connected()) {
    if (millis() - start > MQTT_TIMEOUT_MS) {
      Serial.println("MQTT connect timed out");
      return false;
    }
    mqtt.connect(UNIT_ID);
    delay(300);
  }
  return true;
}

void go_to_sleep() {
  esp_sleep_enable_timer_wakeup(CAPTURE_INTERVAL_MS * 1000ULL);
  Serial.println("Sleeping until next capture cycle...");
  Serial.flush();
  esp_deep_sleep_start();
}

void setup() {
  Serial.begin(115200);
  delay(200);

  snprintf(mqtt_topic, sizeof(mqtt_topic), "coldroot/%s/freshness", UNIT_ID);

  if (!setup_camera() || !setup_model()) {
    Serial.println("Setup failed — retrying after sleep cycle");
    go_to_sleep();
    return;
  }

  if (connect_wifi() && connect_mqtt()) {
    run_inference();
    mqtt.disconnect();
  } else {
    Serial.println("Skipping this cycle — no connectivity");
  }

  WiFi.disconnect(true);
  go_to_sleep();
}

void loop() {
  // unused — device deep-sleeps and restarts setup() each cycle
}
